## arch/arm64/Kconfig.projects
```kconfig
config SEC_A23_PROJECT
	depends on ARCH_BENGAL
	default n
	bool "Samsung A23 Project"
	help
	  Support for Samsung A23 Project

config MACH_A23_EUR_OPEN
	depends on SEC_A23_PROJECT
	default n
	bool "Samsung A23 EUR OPEN"
	help
	  Support for Samsung A23 EUR OPEN device.

config MACH_A23_KOR_SINGLE
	depends on SEC_A23_PROJECT
	default n
	bool "Samsung A23 KOR SINGLE"
	help
	  Support for Samsung A23 KOR SINGLE device.

config MACH_A23_LTN_OPEN
	depends on SEC_A23_PROJECT
	default n
	bool "Samsung A23 LTN OPEN"
	help
	  Support for Samsung A23 LTN OPEN device.
```
