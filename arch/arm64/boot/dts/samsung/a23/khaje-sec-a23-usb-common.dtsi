/* Copyright (c) 2021, The Linux Foundation. All rights reserved.
 *
 * This program is free software; you can redistribute it and/or modify
 * it under the terms of the GNU General Public License version 2 and
 * only version 2 as published by the Free Software Foundation.
 *
 * This program is distributed in the hope that it will be useful,
 * but WITHOUT ANY WARRANTY; without even the implied warranty of
 * MERCHANTABILITY or FITNESS FOR A PARTICULAR PURPOSE.  See the
 * GNU General Public License for more details.
 */
 
&usb0 {
	dwc3@4e00000 {
		maximum-speed = "high-speed";
		dr_mode = "otg";
	};
};

&usb2_phy0 {
	qcom,param-override-seq =
		<0xe7 0x6c>,  /* override_x0 */
		<0xcb 0x70>,  /* override_x1 */
		<0x16 0x74>;  /* override_x2 */
	qcom,param-host-override-seq =
		<0xe7 0x6c>,  /* override_x0 */
		<0xcb 0x70>,  /* override_x1 */
		<0x16 0x74>;  /* override_x2 */
};
