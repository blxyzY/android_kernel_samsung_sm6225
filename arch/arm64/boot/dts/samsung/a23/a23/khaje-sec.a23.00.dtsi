#include "../../khaje-sec-common.dtsi"
#include "../khaje-sec-a23-common.dtsi"
#include "../khaje-sec-a23-pinctrl-common.dtsi"
#include "../khaje-sec-a23-pm-common.dtsi"
#include "khaje-sec-a23-camera-sensor-common.dtsi"

#include "khaje-sec-a23-pinctrl-r00.dtsi"

/ {
	model = "Samsung A23 PROJECT (board-id,00)";
	compatible = "qcom,khaje-idp", "qcom,khaje", "qcom,idp";
	qcom,msm-id = <518 0x10000>;
	qcom,board-id = <0x10022 0>;
	qcom,pmic-id = <0x2D 0x0 0x0 0x0>;
	dtbo-version = <0>;
};
